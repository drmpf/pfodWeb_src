// Board: Arduino UNO
// Connection: Serial @ 115200 baud

/* Code generated by pfodWeb V4.1.2-- 27th July 2026
 */
/* ===== pfod Command for Hello World ====
pfodApp msg {.} --> {,~`0~V1|c0~Hello World}
 */
/*   
   pfodMainMenu.cpp
 * (c)2026 Forward Computing and Control Pty. Ltd.
 * NSW Australia, www.forward.com.au
 * This code is not warranted to be fit for any purpose. You may only use it at your own risk.
 * This generated code may be freely used for both private and commercial use
 * provided this copyright is maintained.
 */

#include "pfodMainMenu.h"
#include <pfodParser.h>
#include <pfodDebugPtr.h>
#include <pfodDwgs.h>
#include <pfodDrawing.h>
#include "Dwg_HelloWorld.h"

// #define DEBUG

// Pin settings

static Print* debugPtr = NULL;  // local to this file
static const unsigned long refresh_ms = 0; // main menu refresh
static int swap01(int in);


unsigned long plot_msOffset = 0; // set by {@} response
bool clearPlot = false; // set by the {@} response code

static pfodMainMenu mainMenu;

pfodMainMenu::pfodMainMenu() {
  initialized = false;
  closeConnectionFnPtr = NULL;
}

void pfodMainMenu::init(pfodCloseConnectionPtr _closeConnectionFnPtr) {
  if (initialized) {
    return;
  }
  (void)debugPtr;  // suppress not used warning
#ifdef DEBUG
  debugPtr = getDebugPtr();
#endif
  initialized = true;
  closeConnectionFnPtr = _closeConnectionFnPtr;
  dwg_HelloWorld.init(); // initialize drawing -- 'Hello World'
}

// the loop routine runs over and over again forever:
void pfodMainMenu::handle(pfodParser& parser) {
  if (!initialized) {
    if (debugPtr) {
      debugPtr->println(" Need to call init_pfodMainMenu() from setup().");
    }
  }
  uint8_t cmd = parser.parse(); // parse incoming data from connection
  // parser returns non-zero when a pfod command is fully parsed
  if (cmd != 0) { // have parsed a complete msg { to }
    uint8_t* pfodFirstArg = parser.getFirstArg(); // may point to \0 if no arguments in this msg.
    pfod_MAYBE_UNUSED(pfodFirstArg); // may not be used, just suppress warning
    long pfodLongRtn; // used for parsing long return arguments, if any
    pfod_MAYBE_UNUSED(pfodLongRtn); // may not be used, just suppress warning
    if ('.' == cmd) {
      // pfodApp has connected and sent {.} , it is asking for the main menu
      if (!parser.isRefresh()) {
        sendMainMenu(parser); // send back the menu designed
      } else {
        sendMainMenuUpdate(parser); // menu is cached just send update
      }

      // handle {@} request
    } else if('@'==cmd) { // pfodApp requested 'current' time
      plot_msOffset = millis(); // capture current millis as offset rawdata timestamps
      clearPlot = true; // clear plot on reconnect as have new plot_msOffset
      parser.print(F("{@`0}")); // return `0 as 'current' raw data milliseconds
    

    // now handle commands returned from button/sliders
    } else if(parser.cmdEquals(dwgMenuItem_Cmd)) { // user touch not handled by dwg, handle it here
      sendMainMenuUpdate(parser); // always send back a pfod msg otherwise pfodApp will disconnect.

    } else if ('!' == cmd) {
      // CloseConnection command
      if (closeConnectionFnPtr) {
        closeConnectionFnPtr(parser.getPfodAppStream());
      }
    } else {
      // unknown command
      parser.print(F("{}")); // always send back a pfod msg otherwise pfodApp will disconnect.
    }
  }
  //  <<<<<<<<<<<  Your other loop() code goes here 
  
}

void pfodMainMenu::sendMainMenu(pfodParser& parser) {
  // !! Remember to change the parser version string OR Clear the cache
  //    every time you edit this method
  parser.menu();  // start a Menu screen pfod message.  Send {,
  // send menu background, format, prompt, refresh and version
  parser.print(F("~"));
  parser.sendRefreshAndVersion(refresh_ms); // send the menu version 
  // send menu items
  parser.print(F("|+")); // start Drawing
  parser.print(dwgMenuItem_Cmd); // drawing menu item cmd
  parser.print(F("~"));
  parser.print(dwg_HelloWorld); // the drawing's loadCmd
  parser.endOfMsg();  // close pfod message. Send }
}

void pfodMainMenu::sendMainMenuUpdate(pfodParser& parser) {
  parser.menuUpdate();  // start an Update Menu pfod message. Send {;
  // send menu items
  parser.print(F("|+")); // drawing menu item update
  parser.print(dwgMenuItem_Cmd);
  parser.endOfMsg();  // close pfod message. Send }
  // ============ end of menu ===========
}

static int swap01(int in) {
  return (in==0)?1:0;
}

handle_mainMenuFnPtr init_pfodMainMenu(pfodCloseConnectionPtr closeConnectionFnPtr) {
  mainMenu.init(closeConnectionFnPtr);
  return handle_pfodMainMenu;
}

void handle_pfodMainMenu(pfodParser& parser) {
  mainMenu.handle(parser);
}
// ============= end generated code =========

