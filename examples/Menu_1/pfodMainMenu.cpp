// Board: Arduino UNO
// Connection: Serial @ 115200 baud

/* Code generated by pfodWeb V4.1.7-- 23th August 2026
 * (c)2026 Forward Computing and Control Pty. Ltd.
 * NSW Australia, www.forward.com.au
 * This code is not warranted to be fit for any purpose. You may only use it at your own risk.
 * This generated code may be freely used for both private and commercial use
 * provided this copyright is maintained.
 */
/* ===== pfod Command for Menu_1 ====
pfodApp msg {.} --> {,<bg n><+4><b>~Arduino Data`0~V1|c0<bg n>~A0 |!c1<bg n>~<-6>|!c2<bg n>`0~<+4><b>Door is ~~Closed\Open~t|!c3<bg n>~<-6>|c4<bg n>`129~PWM Setting ~%`255`0~100~0~|c5<bg s>`0~<+6><b>LED is ~~Off\On~t|c6<bg n>~<+4>Voltage Plot|c7<bg n>~Submenu}
 */
// pfodMainMenu.cpp

#include "pfodMainMenu.h"
#include <pfodParser.h>
#include <pfodDebugPtr.h>
#include "SubMenu_Submenu.h" // sub-menu -- 'Submenu'

// #define DEBUG

pfodMainMenu mainMenu;
// weak: defining this function in any other .cpp replaces it, which is
// how a subclass takes over without editing this file -- see pfodMainMenu.h
pfodMainMenu& __attribute__((weak)) get_pfodMainMenu() { return mainMenu; }

// Pin settings
const int datadisplay_A0_Cmd_pin = A0; // name the analog input pin for 'A0'
const int onoffdisplay_Door_is_Cmd_pin = 4; // name the digital input pin for 'Door is'
const int pwm_PWM_Setting_Cmd_pin = 5; // name the pwm output pin for 'PWM Setting'
const int onoff_LED_is_Cmd_pin = 13; // name the digital output pin for 'LED is'
const int chart_Voltage_Plot_plot_1_pin = A0; // name the analog input pin for 'A0'

static Print* debugPtr = NULL;  // local to this file
static const unsigned long refresh_ms = 1000; // main menu refresh
float getPlotVarScaling(long varMax, long varMin, float displayMax, float displayMin);

int datadisplay_A0_var = 0; // data display variable for 'A0' range 0 to 1023
pfodDelay datadisplay_A0_Cmd_adcTimer; // ADC timer
unsigned long datadisplay_A0_Cmd_ADC_READ_INTERVAL = 1000; // 1sec, edit this to change adc read interval
void datadisplay_A0_Cmd_readADC();
int onoffdisplay_Door_is_var = 0; // display variable for 'Door is'  0=Closed 1=Open 
int pwm_PWM_Setting_var = 0; // initial value for 'PWM Setting' range 0 to 255
int onoff_LED_is_var = 0; // name the variable for 'LED is'  0=Off 1=On 
static unsigned long onoff_LED_is_Cmd_pulseStartTime=0; // the time when onoff_LED_is_Cmd pulse started
static bool onoff_LED_is_Cmd_pulseRunning = false; // true when onoff_LED_is_Cmd pulse running
static unsigned long onoff_LED_is_Cmd_PULSE_LENGTH = 10000; // 10.0 secs
static void onoff_LED_is_Cmd_checkPulse();

unsigned long plot_msOffset = 0; // set by {@} response
bool clearPlot = false; // set by the {@} response code

// plotting data variables for 'Voltage Plot'
static int chart_Voltage_Plot_plot_1_varMin = 0;
static int chart_Voltage_Plot_plot_1_var = chart_Voltage_Plot_plot_1_varMin;
static float chart_Voltage_Plot_plot_1_scaling;
static float chart_Voltage_Plot_plot_1_varDisplayMin = 0.0;
static int chart_Voltage_Plot_plot_2_varMin = 0;
static int chart_Voltage_Plot_plot_2_var = chart_Voltage_Plot_plot_2_varMin;
static float chart_Voltage_Plot_plot_2_scaling;
static float chart_Voltage_Plot_plot_2_varDisplayMin = 0.0;
static int chart_Voltage_Plot_plot_3_varMin = 0;
static int chart_Voltage_Plot_plot_3_var = chart_Voltage_Plot_plot_3_varMin;
static float chart_Voltage_Plot_plot_3_scaling;
static float chart_Voltage_Plot_plot_3_varDisplayMin = 0.0;
static pfodDelay chart_Voltage_Plot_plotDataTimer; // plot data timer
static unsigned long chart_Voltage_Plot_PLOT_DATA_INTERVAL = 1000;// ms == 1 sec, edit this to change the plot data interval

void pfodMainMenu::onPwmSettingChanged(int value) {
  (void)value;
  analogWrite(pwm_PWM_Setting_Cmd_pin, value); // set output
}

void pfodMainMenu::onLedIsChanged(int value) {
  (void)value;
  digitalWrite(onoff_LED_is_Cmd_pin, value); // set output
  if (value == 1) {
    onoff_LED_is_Cmd_pulseStartTime = millis();
    onoff_LED_is_Cmd_pulseRunning = true;
  } else {
    onoff_LED_is_Cmd_pulseRunning = false;
  }
}

void pfodMainMenu::chart_Voltage_Plot_readPlotData() {
  // assign values to plot variables from your loop variables or read ADC inputs
  chart_Voltage_Plot_plot_1_var = analogRead(chart_Voltage_Plot_plot_1_pin);  // read ADC input
  chart_Voltage_Plot_plot_2_var = chart_Voltage_Plot_plot_2_varMin; //<<< replace this Min value with your actual data
  chart_Voltage_Plot_plot_3_var = chart_Voltage_Plot_plot_3_varMin; //<<< replace this Min value with your actual data
}

pfodMainMenu::pfodMainMenu() {
  initialized = false;
  closeConnectionFnPtr = NULL;
}

void pfodMainMenu::init(pfodCloseConnectionPtr _closeConnectionFnPtr) {
  if (initialized) {
    return;
  }
  (void)debugPtr;  // suppress not used warning
#ifdef DEBUG
  debugPtr = getDebugPtr();
#endif
  initialized = true;
  closeConnectionFnPtr = _closeConnectionFnPtr;
  datadisplay_A0_Cmd_adcTimer.start(datadisplay_A0_Cmd_ADC_READ_INTERVAL); // start ADC timer
  pinMode(onoffdisplay_Door_is_Cmd_pin, INPUT); // input for 'Door is'
  pinMode(pwm_PWM_Setting_Cmd_pin, OUTPUT); // output for 'PWM Setting' is initially 0,
  analogWrite(pwm_PWM_Setting_Cmd_pin,pwm_PWM_Setting_var); // set output
  pinMode(onoff_LED_is_Cmd_pin, OUTPUT); // digital output for 'LED is' is initially LOW,
  digitalWrite(onoff_LED_is_Cmd_pin,onoff_LED_is_var); // set output

  // calculate the plot vars scaling here once to reduce computation
  chart_Voltage_Plot_plot_1_scaling = getPlotVarScaling(1023,chart_Voltage_Plot_plot_1_varMin,5.0,chart_Voltage_Plot_plot_1_varDisplayMin);
  chart_Voltage_Plot_plot_2_scaling = getPlotVarScaling(1023,chart_Voltage_Plot_plot_2_varMin,5.0,chart_Voltage_Plot_plot_2_varDisplayMin);
  chart_Voltage_Plot_plot_3_scaling = getPlotVarScaling(1023,chart_Voltage_Plot_plot_3_varMin,5.0,chart_Voltage_Plot_plot_3_varDisplayMin);

  chart_Voltage_Plot_plotDataTimer.start(chart_Voltage_Plot_PLOT_DATA_INTERVAL); // start plot timer
  get_subMenu_Submenu().init(); // initialize sub-menu
}

// the loop routine runs over and over again forever:
void pfodMainMenu::handle(pfodParser& parser) {
  if (!initialized) {
    if (debugPtr) {
      debugPtr->println(F(" Need to call init_pfodMainMenu() from setup()."));
    }
  }
  uint8_t cmd = parser.parse(); // parse incoming data from connection
  // parser returns non-zero when a pfod command is fully parsed
  if (cmd != 0) { // have parsed a complete msg { to }
    uint8_t* pfodFirstArg = parser.getFirstArg(); // may point to \0 if no arguments in this msg.
    pfod_MAYBE_UNUSED(pfodFirstArg); // may not be used, just suppress warning
    long pfodLongRtn; // used for parsing long return arguments, if any
    pfod_MAYBE_UNUSED(pfodLongRtn); // may not be used, just suppress warning
    if ('.' == cmd) {
      // pfodApp has connected and sent {.} , it is asking for the main menu
      if (!parser.isRefresh()) {
        sendMainMenu(parser); // send back the menu designed
      } else {
        sendMainMenuUpdate(parser); // menu is cached just send update
      }

      // handle {@} request
    } else if('@'==cmd) { // pfodApp requested 'current' time
      plot_msOffset = millis(); // capture current millis as offset rawdata timestamps
      clearPlot = true; // clear plot on reconnect as have new plot_msOffset
      parser.print(F("{@`0}")); // return `0 as 'current' raw data milliseconds
    

    // now handle commands returned from button/sliders
//    } else if(parser.cmdEquals(datadisplay_A0_Cmd)) { // pfodApp NEVER sends this cmd -- 'A0'

//    } else if(parser.cmdEquals(label__Cmd_2)) { // pfodApp NEVER sends this cmd -- 'label'

//    } else if(parser.cmdEquals(onoffdisplay_Door_is_Cmd)) { // pfodApp NEVER sends this cmd -- 'Door is'

//    } else if(parser.cmdEquals(label__Cmd)) { // pfodApp NEVER sends this cmd -- 'label'

    } else if(parser.cmdEquals(pwm_PWM_Setting_Cmd)) { // user moved slider -- 'PWM Setting'
      parser.parseLong(pfodFirstArg,&pfodLongRtn); // parse first arg as a long
      pwm_PWM_Setting_var = (int)pfodLongRtn; // set variable
      onPwmSettingChanged(pwm_PWM_Setting_var); // virtual hook -- hardware/action handling
      sendMainMenuUpdate(parser); // always send back a pfod msg otherwise pfodApp will disconnect.

    } else if(parser.cmdEquals(onoff_LED_is_Cmd)) { // user moved slider -- 'LED is'
      parser.parseLong(pfodFirstArg,&pfodLongRtn); // parse first arg as a long
      onoff_LED_is_var = (int)pfodLongRtn; // set variable
      onLedIsChanged(onoff_LED_is_var); // virtual hook -- hardware/action handling
      sendMainMenuUpdate(parser); // always send back a pfod msg otherwise pfodApp will disconnect.

    } else if(parser.cmdEquals(chart_Voltage_Plot_Cmd)) { // user pressed -- 'Voltage Plot'
      // in the main Menu of Menu_1
      // return plotting msg.
      parser.print(F("{=Voltage at A0~mm:ss"));
      if (clearPlot) {
        clearPlot = false;
        parser.print(F("~C"));
      }
      parser.print(F("|time (mm:ss)|A0~5.0~0~Volts||}"));

    } else if(parser.cmdEquals(submenu_Submenu_Cmd)) { // user pressed sub-menu button -- 'Submenu'
      if (!parser.isRefresh()) {
        get_subMenu_Submenu().sendMenu(parser); // send the sub-menu
      } else {
        get_subMenu_Submenu().sendMenuUpdate(parser); // refresh the sub-menu
      }

    } else if (get_subMenu_Submenu().handleCmd(parser, cmd, pfodFirstArg, &pfodLongRtn)) {
      // handled by the sub-menu's own items
    } else if ('!' == cmd) {
      // CloseConnection command
      if (closeConnectionFnPtr) {
        closeConnectionFnPtr(parser.getPfodAppStream());
      }
    } else {
      // unknown command
      parser.print(F("{}")); // always send back a pfod msg otherwise pfodApp will disconnect.
    }
  }
  onoff_LED_is_Cmd_checkPulse(); 
  onoffdisplay_Door_is_var = digitalRead(onoffdisplay_Door_is_Cmd_pin); // read input pin
  datadisplay_A0_Cmd_readADC(); 
  tickCharts(parser); // stream every chart's data (this level + every nested sub-menu)
  //  <<<<<<<<<<<  Your other loop() code goes here 
  
}

void pfodMainMenu::tickCharts(pfodParser &parser) {
  chart_Voltage_Plot_sendData(parser);
}

void pfodMainMenu::chart_Voltage_Plot_sendData(pfodParser &parser) {
  if (chart_Voltage_Plot_plotDataTimer.justFinished()) {
    chart_Voltage_Plot_plotDataTimer.repeat(); // restart plot data timer, without drift
    chart_Voltage_Plot_readPlotData(); // virtual hook -- assigns the 3 plot vars
    // send plot data in CSV format
    parser.print(millis() - plot_msOffset); // time in milliseconds
    parser.print(','); parser.print(((float)(chart_Voltage_Plot_plot_1_var-chart_Voltage_Plot_plot_1_varMin)) * chart_Voltage_Plot_plot_1_scaling + chart_Voltage_Plot_plot_1_varDisplayMin);
    parser.print(','); parser.print(((float)(chart_Voltage_Plot_plot_2_var-chart_Voltage_Plot_plot_2_varMin)) * chart_Voltage_Plot_plot_2_scaling + chart_Voltage_Plot_plot_2_varDisplayMin);
    parser.print(','); parser.print(((float)(chart_Voltage_Plot_plot_3_var-chart_Voltage_Plot_plot_3_varMin)) * chart_Voltage_Plot_plot_3_scaling + chart_Voltage_Plot_plot_3_varDisplayMin);
    parser.println(); // end of CSV data record
  }
}

float getPlotVarScaling(long varMax, long varMin, float displayMax, float displayMin) {
  long varRange = varMax - varMin;
  if (varRange == 0) { varRange = 1; } // prevent divide by zero
  return (displayMax - displayMin)/((float)varRange);
}

void pfodMainMenu::sendMainMenu(pfodParser& parser) {
  // !! Remember to change the parser version string OR Clear the cache
  //    every time you edit this method
  parser.menu();  // start a Menu screen pfod message.  Send {,
  // send menu background, format, prompt, refresh and version
  parser.print(F("<bg n><+4><b>~Arduino Data")); // background n, +4 size, bold
  parser.sendRefreshAndVersion(refresh_ms); // send the menu version 
  // send menu items
  parser.onOffDisplay(datadisplay_A0_Cmd); // start Data Display (outputs |!cmd)
  parser.print(F("<bg n>")); // background n
  parser.print('`');
  parser.print(datadisplay_A0_var); // output the current value
  parser.print(F("~A0 ~V`1023`0~5.0~0~"));
  parser.label(label__Cmd_2); // start Label
  parser.print(F("<bg n><-6>")); // background n, -6 size
  parser.print(F("~"));
  parser.onOffDisplay(onoffdisplay_Door_is_Cmd); // start On/Off Display (outputs |!cmd)
  parser.print(F("<bg n><+4><b>")); // background n, +4 size, bold
  parser.print('`');
  parser.print(onoffdisplay_Door_is_var); // output the current state 0 Closed or 1 Open
  parser.print(F("~Door is ~~Closed\\Open~t"));
  // Note the \\\\ inside the ' 's to send \\ ...
  parser.label(label__Cmd); // start Label
  parser.print(F("<bg n><-6>")); // background n, -6 size
  parser.print(F("~"));
  parser.slider(pwm_PWM_Setting_Cmd); // start Slider
  parser.print(F("<bg n>")); // background n
  parser.print('`');
  parser.print(pwm_PWM_Setting_var); // output the current value 
  parser.print(F("~PWM Setting ~%`255`0~100~0~"));
  parser.slider(onoff_LED_is_Cmd); // start Slider
  parser.print(F("<bg s><+6><b>")); // background silver, +6 size, bold
  parser.print('`');
  parser.print(onoff_LED_is_var); // output the current value 
  parser.print(F("~LED is ~~Off\\On~t"));
  // Note the \\\\ inside the ' 's to send \\ ...
  parser.button(chart_Voltage_Plot_Cmd); // start Button (opens chart)
  parser.print(F("<bg n><+4>")); // background n, +4 size
  parser.print(F("~Voltage Plot"));
  parser.button(submenu_Submenu_Cmd); // start Button (opens sub-menu)
  parser.print(F("<bg n>")); // background n
  parser.print(F("~Submenu"));
  parser.endOfMsg();  // close pfod message. Send }
}

void pfodMainMenu::sendMainMenuUpdate(pfodParser& parser) {
  parser.menuUpdate();  // start an Update Menu pfod message. Send {;
  // send menu items
  parser.onOffDisplay(datadisplay_A0_Cmd); // start Data Display (outputs |!cmd)
  parser.print('`');
  parser.print(datadisplay_A0_var); // output the current value
  parser.label(label__Cmd_2); // start Label
  parser.onOffDisplay(onoffdisplay_Door_is_Cmd); // start On/Off Display (outputs |!cmd)
  parser.print('`');
  parser.print(onoffdisplay_Door_is_var); // output the current state
  parser.label(label__Cmd); // start Label
  parser.slider(pwm_PWM_Setting_Cmd); // start Slider
  parser.print('`');
  parser.print(pwm_PWM_Setting_var); // output the current value 
  parser.slider(onoff_LED_is_Cmd); // start Slider
  parser.print('`');
  parser.print(onoff_LED_is_var); // output the current value 
  parser.button(chart_Voltage_Plot_Cmd); // start Button (chart)
  parser.button(submenu_Submenu_Cmd); // start Button (sub-menu)
  parser.endOfMsg();  // close pfod message. Send }
  // ============ end of menu ===========
}

void datadisplay_A0_Cmd_readADC() {
  if (datadisplay_A0_Cmd_adcTimer.justFinished()) {
    datadisplay_A0_Cmd_adcTimer.repeat(); // restart timer, without drift
    datadisplay_A0_var = analogRead(datadisplay_A0_Cmd_pin);  // read ADC input
  }
}

static void onoff_LED_is_Cmd_checkPulse() {
  if (onoff_LED_is_Cmd_pulseRunning && ((millis() - onoff_LED_is_Cmd_pulseStartTime) > onoff_LED_is_Cmd_PULSE_LENGTH)) {
    onoff_LED_is_Cmd_pulseRunning = false; // timer finished
    onoff_LED_is_var = 0;  // return output to LOW
    digitalWrite(onoff_LED_is_Cmd_pin,onoff_LED_is_var); // update output pin
  }
}

handle_mainMenuFnPtr init_pfodMainMenu(pfodCloseConnectionPtr _closeConnectionFnPtr) {
  get_pfodMainMenu().init(_closeConnectionFnPtr);
  return handle_pfodMainMenu;
}

void handle_pfodMainMenu(pfodParser& parser) {
  get_pfodMainMenu().handle(parser);
}
// ============= end generated code =========

